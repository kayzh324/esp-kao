## application/edge_agent/boards/kayzh/esp32_S3_test_board/sdkconfig.defaults.board
```kconfig
CONFIG_ESP_DEFAULT_CPU_FREQ_MHZ_240=y
CONFIG_ESPTOOLPY_FLASHMODE_QIO=y
CONFIG_ESPTOOLPY_FLASHFREQ_80M=y
CONFIG_ESPTOOLPY_FLASHSIZE_16MB=y
CONFIG_PARTITION_TABLE_CUSTOM=y
CONFIG_PARTITION_TABLE_CUSTOM_FILENAME="partitions_16MB.csv"
CONFIG_SPIRAM=y
CONFIG_SPIRAM_MODE_OCT=y
CONFIG_SPIRAM_SPEED_80M=y

CONFIG_ESP_BOARD_PERIPH_I2S_SUPPORT=y
CONFIG_ESP_VIDEO_ENABLE_USB_UVC_VIDEO_DEVICE=y
CONFIG_USB_HOST_CONTROL_TRANSFER_MAX_SIZE=1024
CONFIG_USB_UVC_VIDEO_DEVICE_URB_SIZE=4096
CONFIG_ESP_BOARD_DEV_FS_FAT_SUB_SPI_SUPPORT=y
CONFIG_ESP_BOARD_DEV_FS_FAT_SUPPORT=y

CONFIG_APP_CLAW_LUA_MODULE_LCD=y
CONFIG_APP_CLAW_LUA_MODULE_IMU=y
CONFIG_LUA_MODULE_IMU_CHIP_BMI270=y
CONFIG_APP_CLAW_LUA_MODULE_MAGNETOMETER=y
CONFIG_LUA_MODULE_MAGNETOMETER_CHIP_BMM150=y
CONFIG_LUA_MODULE_SCD41_SENSOR_ENABLE=y

# XPT2046 touch is a custom device, so the dev_lcd_touch auto-defaults do not
# fire; enable the Lua module explicitly.

CONFIG_ESP_BOARD_PERIPH_LEDC_SUPPORT=y

CONFIG_LV_BUILD_EXAMPLES=n

# custom usb hid setting
CONFIG_APP_CLAW_LUA_DRIVER_USB_HOST_HID=y
CONFIG_ESP_HOSTED_SDIO_RESET_DELAY_MS=2000
```

## components/claw_modules/claw_core/test_apps/psram_http_body_test/sdkconfig.defaults
```kconfig
# For IDF 5.0
CONFIG_ESP_DEFAULT_CPU_FREQ_MHZ_240=y
CONFIG_FREERTOS_HZ=1000
CONFIG_ESP_TASK_WDT_EN=n
CONFIG_LWIP_NETIF_LOOPBACK=y
CONFIG_LWIP_LOOPBACK_MAX_PBUFS=8

# Board: esp32_S3_test_board (N16R8: 16MB Flash + 8MB PSRAM)
CONFIG_ESPTOOLPY_FLASHMODE_QIO=y
CONFIG_ESPTOOLPY_FLASHFREQ_80M=y
CONFIG_ESPTOOLPY_FLASHSIZE_16MB=y
CONFIG_SPIRAM=y
CONFIG_SPIRAM_MODE_OCT=y
CONFIG_SPIRAM_SPEED_80M=y
CONFIG_SPIRAM_USE_MALLOC=y
CONFIG_SPIRAM_MALLOC_ALWAYSINTERNAL=0
CONFIG_SPIRAM_BOOT_INIT=y
CONFIG_ESP32S3_SPIRAM_SUPPORT=y
CONFIG_SPIRAM_MEMTEST=n
```

## components/claw_modules/claw_manager/Kconfig
```kconfig
menu "Claw Manager"

    config CLAW_AGENT_MGR_MAX_SUBAGENTS
        int "Maximum concurrent subagents"
        default 4 if CLAW_TIER_ESP32P4 || CLAW_TIER_ESP32S31
        default 3
        range 1 8
        help
            Maximum number of live subagent runtime slots managed by claw_agent_mgr.
            The default follows the claw_tier choice: the S3-floor tier keeps 3,
            higher tiers allow one more concurrent subagent.

endmenu
```

## components/claw_modules/claw_tier/Kconfig
```kconfig
menu "Claw Tier"

    choice CLAW_TIER
        prompt "Hardware performance tier"
        default CLAW_TIER_ESP32P4 if IDF_TARGET_ESP32P4
        default CLAW_TIER_ESP32S31 if IDF_TARGET_ESP32S31
        default CLAW_TIER_ESP32S3
        help
            Selects the context/memory budget profile used by the agent stack
            (claw_tier.h). The default follows the build target; override it here
            when a board has more or less RAM than the chip's reference design.

            ESP32-S3 is the measured performance floor the budgets were tuned
            against. Higher tiers raise the per-request byte budgets so bigger
            contexts fit in one round instead of being evicted and re-read.

        config CLAW_TIER_ESP32S3
            bool "ESP32-S3 (baseline / floor)"
        config CLAW_TIER_ESP32P4
            bool "ESP32-P4 (high performance)"
        config CLAW_TIER_ESP32S31
            bool "ESP32-S31 (high performance)"
    endchoice

endmenu
```

## components/lua_modules/lua_module_scd41_sensor/Kconfig
```kconfig
menu "Lua SCD41 Sensor Module"

    config LUA_MODULE_SCD41_SENSOR_ENABLE
        bool "Enable SCD41 sensor Lua module"
        default y
        help
            Build the SCD41 CO2, temperature, and humidity sensor Lua module.

endmenu
```
